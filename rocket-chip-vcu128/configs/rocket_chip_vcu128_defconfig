## rocket-chip-vcu128/configs/rocket_chip_vcu128_defconfig
```kconfig
# Architecture
BR2_riscv=y
BR2_RISCV_64=y

# System
BR2_SYSTEM_DHCP="eth0"
BR2_TARGET_GENERIC_GETTY=y

# Filesystem
BR2_TARGET_ROOTFS_CPIO=y

# Linux headers same as kernel, a 5.10 series
BR2_PACKAGE_HOST_LINUX_HEADERS_CUSTOM_5_10=y

# Kernel
BR2_LINUX_KERNEL=n

# Bootloader
BR2_TARGET_OPENSBI=n

# Mirrors
BR2_GNU_MIRROR="https://mirrors.tuna.tsinghua.edu.cn/gnu"

# Getty
BR2_TARGET_GENERIC_GETTY_PORT="ttyS0"

# Packages
BR2_PACKAGE_MTD=y
BR2_PACKAGE_MTD_MKFSJFFS2=y
BR2_PACKAGE_MTD_MTDPART=y
BR2_PACKAGE_MTD_JFFS2DUMP=y
BR2_PACKAGE_LIBGPIOD=y
BR2_PACKAGE_LIBGPIOD_TOOLS=y
BR2_PACKAGE_ETHTOOL=y
BR2_PACKAGE_NTP=y
BR2_PACKAGE_NTP_SNTP=y
BR2_PACKAGE_NTP_NTPDATE=y
```
